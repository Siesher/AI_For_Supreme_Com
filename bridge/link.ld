/* Auto-generated by gen_link_script.py — do not edit by hand. */
/* Maps asm("0x...") symbol names to absolute SupCom:FA addresses. */
/* Build with MinGW GCC: cmake -G "MinGW Makefiles" ... */
/* NOTE: No SECTIONS directive — MinGW's built-in PE script handles  */
/* section layout. PROVIDE-only scripts extend it without overriding. */

PROVIDE("0x00402370" = 0x00402370);
PROVIDE("0x405550" = 0x405550);
PROVIDE("0x4059e0" = 0x4059e0);
PROVIDE("0x41c990" = 0x41c990);
PROVIDE("0x00431390" = 0x00431390);
PROVIDE("0x452fc0" = 0x452fc0);
PROVIDE("0x00457880" = 0x00457880);
PROVIDE("0x4579d0" = 0x4579d0);
PROVIDE("0x4f2730" = 0x4f2730);
PROVIDE("0x9072b0" = 0x9072b0);
PROVIDE("0x9072c0" = 0x9072c0);
PROVIDE("0x9072d0" = 0x9072d0);
PROVIDE("0x9073b0" = 0x9073b0);
PROVIDE("0x9073e0" = 0x9073e0);
PROVIDE("0x907630" = 0x907630);
PROVIDE("0x9077c0" = 0x9077c0);
PROVIDE("0x907810" = 0x907810);
PROVIDE("0x907910" = 0x907910);
PROVIDE("0x907970" = 0x907970);
PROVIDE("0x907a30" = 0x907a30);
PROVIDE("0x907a90" = 0x907a90);
PROVIDE("0x907bc0" = 0x907bc0);
PROVIDE("0x907c90" = 0x907c90);
PROVIDE("0x907d10" = 0x907d10);
PROVIDE("0x907d80" = 0x907d80);
PROVIDE("0x907e00" = 0x907e00);
PROVIDE("0x907e50" = 0x907e50);
PROVIDE("0x907ed0" = 0x907ed0);
PROVIDE("0x907f50" = 0x907f50);
PROVIDE("0x907fa0" = 0x907fa0);
PROVIDE("0x907ff0" = 0x907ff0);
PROVIDE("0x9080c0" = 0x9080c0);
PROVIDE("0x9081f0" = 0x9081f0);
PROVIDE("0x908240" = 0x908240);
PROVIDE("0x908320" = 0x908320);
PROVIDE("0x908370" = 0x908370);
PROVIDE("0x908450" = 0x908450);
PROVIDE("0x9084e0" = 0x9084e0);
PROVIDE("0x908760" = 0x908760);
PROVIDE("0x9087a0" = 0x9087a0);
PROVIDE("0x908810" = 0x908810);
PROVIDE("0x908890" = 0x908890);
PROVIDE("0x9088e0" = 0x9088e0);
PROVIDE("0x908ba0" = 0x908ba0);
PROVIDE("0x908c10" = 0x908c10);
PROVIDE("0x908ca0" = 0x908ca0);
PROVIDE("0x908f60" = 0x908f60);
PROVIDE("0x9091e0" = 0x9091e0);
PROVIDE("0x9093b0" = 0x9093b0);
PROVIDE("0x9095c0" = 0x9095c0);
PROVIDE("0x909600" = 0x909600);
PROVIDE("0x909650" = 0x909650);
PROVIDE("0x9096a0" = 0x9096a0);
PROVIDE("0x9096f0" = 0x9096f0);
PROVIDE("0x909750" = 0x909750);
PROVIDE("0x9097d0" = 0x9097d0);
PROVIDE("0x909840" = 0x909840);
PROVIDE("0x909940" = 0x909940);
PROVIDE("0x9099b0" = 0x9099b0);
PROVIDE("0x909af0" = 0x909af0);
PROVIDE("0x909ce0" = 0x909ce0);
PROVIDE("0x90a160" = 0x90a160);
PROVIDE("0x90a180" = 0x90a180);
PROVIDE("0x90a410" = 0x90a410);
PROVIDE("0x90a520" = 0x90a520);
PROVIDE("0x90a5d0" = 0x90a5d0);
PROVIDE("0x90a600" = 0x90a600);
PROVIDE("0x90a690" = 0x90a690);
PROVIDE("0x90a6b0" = 0x90a6b0);
PROVIDE("0x90aad0" = 0x90aad0);
PROVIDE("0x90ac10" = 0x90ac10);
PROVIDE("0x90ad00" = 0x90ad00);
PROVIDE("0x90ad30" = 0x90ad30);
PROVIDE("0x90bee0" = 0x90bee0);
PROVIDE("0x90bef0" = 0x90bef0);
PROVIDE("0x90bf70" = 0x90bf70);
PROVIDE("0x90bfb0" = 0x90bfb0);
PROVIDE("0x90c170" = 0x90c170);
PROVIDE("0x90c1d0" = 0x90c1d0);
PROVIDE("0x90c340" = 0x90c340);
PROVIDE("0x90c3d0" = 0x90c3d0);
PROVIDE("0x90c460" = 0x90c460);
PROVIDE("0x90c4c0" = 0x90c4c0);
PROVIDE("0x90c530" = 0x90c530);
PROVIDE("0x90c590" = 0x90c590);
PROVIDE("0x90c5a0" = 0x90c5a0);
PROVIDE("0x90c5f0" = 0x90c5f0);
PROVIDE("0x90c640" = 0x90c640);
PROVIDE("0x90c690" = 0x90c690);
PROVIDE("0x90c6e0" = 0x90c6e0);
PROVIDE("0x90c740" = 0x90c740);
PROVIDE("0x90c780" = 0x90c780);
PROVIDE("0x90c7a0" = 0x90c7a0);
PROVIDE("0x90c800" = 0x90c800);
PROVIDE("0x90c890" = 0x90c890);
PROVIDE("0x90c980" = 0x90c980);
PROVIDE("0x90c9f0" = 0x90c9f0);
PROVIDE("0x90ca40" = 0x90ca40);
PROVIDE("0x90ca90" = 0x90ca90);
PROVIDE("0x90cb10" = 0x90cb10);
PROVIDE("0x90cbb0" = 0x90cbb0);
PROVIDE("0x90cc10" = 0x90cc10);
PROVIDE("0x90cc50" = 0x90cc50);
PROVIDE("0x90cc90" = 0x90cc90);
PROVIDE("0x90cd00" = 0x90cd00);
PROVIDE("0x90cd40" = 0x90cd40);
PROVIDE("0x90cd80" = 0x90cd80);
PROVIDE("0x90cdf0" = 0x90cdf0);
PROVIDE("0x90ce50" = 0x90ce50);
PROVIDE("0x90ce90" = 0x90ce90);
PROVIDE("0x90ced0" = 0x90ced0);
PROVIDE("0x90cf80" = 0x90cf80);
PROVIDE("0x90cfc0" = 0x90cfc0);
PROVIDE("0x90d000" = 0x90d000);
PROVIDE("0x90d050" = 0x90d050);
PROVIDE("0x90d0a0" = 0x90d0a0);
PROVIDE("0x90d110" = 0x90d110);
PROVIDE("0x90d180" = 0x90d180);
PROVIDE("0x90d1f0" = 0x90d1f0);
PROVIDE("0x90d260" = 0x90d260);
PROVIDE("0x90d2a0" = 0x90d2a0);
PROVIDE("0x90d2f0" = 0x90d2f0);
PROVIDE("0x90d340" = 0x90d340);
PROVIDE("0x90d3b0" = 0x90d3b0);
PROVIDE("0x90d400" = 0x90d400);
PROVIDE("0x90d430" = 0x90d430);
PROVIDE("0x90d5c0" = 0x90d5c0);
PROVIDE("0x90d650" = 0x90d650);
PROVIDE("0x90d660" = 0x90d660);
PROVIDE("0x90d670" = 0x90d670);
PROVIDE("0x90d6c0" = 0x90d6c0);
PROVIDE("0x90d6d0" = 0x90d6d0);
PROVIDE("0x90d740" = 0x90d740);
PROVIDE("0x90d7e0" = 0x90d7e0);
PROVIDE("0x90d9a0" = 0x90d9a0);
PROVIDE("0x90da00" = 0x90da00);
PROVIDE("0x90db80" = 0x90db80);
PROVIDE("0x90dbf0" = 0x90dbf0);
PROVIDE("0x90dc20" = 0x90dc20);
PROVIDE("0x90dc70" = 0x90dc70);
PROVIDE("0x90dcf0" = 0x90dcf0);
PROVIDE("0x90dd10" = 0x90dd10);
PROVIDE("0x90dd40" = 0x90dd40);
PROVIDE("0x90dda0" = 0x90dda0);
PROVIDE("0x90de00" = 0x90de00);
PROVIDE("0x90dfb0" = 0x90dfb0);
PROVIDE("0x90e090" = 0x90e090);
PROVIDE("0x90e260" = 0x90e260);
PROVIDE("0x90e2a0" = 0x90e2a0);
PROVIDE("0x90e300" = 0x90e300);
PROVIDE("0x90e330" = 0x90e330);
PROVIDE("0x90e370" = 0x90e370);
PROVIDE("0x90e400" = 0x90e400);
PROVIDE("0x90e5d0" = 0x90e5d0);
PROVIDE("0x90e760" = 0x90e760);
PROVIDE("0x90e870" = 0x90e870);
PROVIDE("0x90e8d0" = 0x90e8d0);
PROVIDE("0x90e900" = 0x90e900);
PROVIDE("0x90e9a0" = 0x90e9a0);
PROVIDE("0x90ea20" = 0x90ea20);
PROVIDE("0x90ea70" = 0x90ea70);
PROVIDE("0x90eaa0" = 0x90eaa0);
PROVIDE("0x90eb10" = 0x90eb10);
PROVIDE("0x90eb70" = 0x90eb70);
PROVIDE("0x90ebf0" = 0x90ebf0);
PROVIDE("0x90fd90" = 0x90fd90);
PROVIDE("0x911ea0" = 0x911ea0);
PROVIDE("0x9124c0" = 0x9124c0);
PROVIDE("0x912560" = 0x912560);
PROVIDE("0x9125b0" = 0x9125b0);
PROVIDE("0x9125c0" = 0x9125c0);
PROVIDE("0x9125d0" = 0x9125d0);
PROVIDE("0x9125e0" = 0x9125e0);
PROVIDE("0x912680" = 0x912680);
PROVIDE("0x9126f0" = 0x9126f0);
PROVIDE("0x00913270" = 0x00913270);
PROVIDE("0x9132f0" = 0x9132f0);
PROVIDE("0x009133a0" = 0x009133a0);
PROVIDE("0x00913990" = 0x00913990);
PROVIDE("0x913e40" = 0x913e40);
PROVIDE("0x00914430" = 0x00914430);
PROVIDE("0x914610" = 0x914610);
PROVIDE("0x91a110" = 0x91a110);
PROVIDE("0x91a4b0" = 0x91a4b0);
PROVIDE("0x923690" = 0x923690);
PROVIDE("0x924050" = 0x924050);
PROVIDE("0x924060" = 0x924060);
PROVIDE("0x924080" = 0x924080);
PROVIDE("0x9240a0" = 0x9240a0);
PROVIDE("0x9240b0" = 0x9240b0);
PROVIDE("0x9243e0" = 0x9243e0);
PROVIDE("0x9246d0" = 0x9246d0);
PROVIDE("0x926ef0" = 0x926ef0);
PROVIDE("0x00927560" = 0x00927560);
PROVIDE("0x00928420" = 0x00928420);
PROVIDE("0x00928450" = 0x00928450);
PROVIDE("0x009293e0" = 0x009293e0);
PROVIDE("0x00929450" = 0x00929450);
PROVIDE("0x00929810" = 0x00929810);
PROVIDE("0x937c30" = 0x937c30);
PROVIDE("0x937cb0" = 0x937cb0);
PROVIDE("0x937d30" = 0x937d30);
PROVIDE("0x938720" = 0x938720);
PROVIDE("0x957ab0" = 0x957ab0);
PROVIDE("0x957b00" = 0x957b00);
PROVIDE("0x957ea0" = 0x957ea0);
PROVIDE("0x958b20" = 0x958b20);
PROVIDE("0x958c40" = 0x958c40);
PROVIDE("0x9c4940" = 0x9c4940);
PROVIDE("0xa825b9" = 0xa825b9);
PROVIDE("0xa82f32" = 0xa82f32);
PROVIDE("0xa89110" = 0xa89110);
PROVIDE("0xa89190" = 0xa89190);
PROVIDE("0x00a89950" = 0x00a89950);
PROVIDE("0xa94450" = 0xa94450);
PROVIDE("0xa9b4e6" = 0xa9b4e6);
PROVIDE("0xaa549e" = 0xaa549e);
PROVIDE("0x00d474d8" = 0x00d474d8);
